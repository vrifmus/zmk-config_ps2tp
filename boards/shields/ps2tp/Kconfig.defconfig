## config/west.yml
```yaml
manifest:
  remotes:
    - name: zmkfirmware
      url-base: https://github.com/zmkfirmware
    - name: infused-kim
      url-base: https://github.com/infused-kim
  projects:
    # - name: zmk
    #   remote: zmkfirmware
    #   revision: main
    #   import: app/west.yml
    - name: zmk
      remote: infused-kim
      revision: pr-testing/mouse_ps2_module_base
      import: app/west.yml
    - name: kb_zmk_ps2_mouse_trackpoint_driver
      remote: infused-kim
      revision: dev/2024-04-acceleration
  self:
    path: config
```
