/*
 * Copyright (c) 2020 The ZMK Contributors
 *
 * SPDX-License-Identifier: MIT
 */

#include <behaviors.dtsi>
#include <dt-bindings/zmk/keys.h>

//#include <dt-bindings/zmk/mouse.h>
//#include <behaviors/mouse_keys.dtsi>

#include <dt-bindings/zmk/pointing.h>
#include "include/mouse_tp.dtsi"

/ {
    keymap {
        compatible = "zmk,keymap";

        default_layer {
            bindings = <&sys_reset>;
        };
    };
};