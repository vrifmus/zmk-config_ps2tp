/ {
    chosen {
        zmk,kscan = &kscan0;
    };
    
    kscan0: kscan {
        compatible = "zmk,kscan-mock";
        label = "KSCAN";
        columns = <0>;
        rows = <0>;
        events = <>;
    };
};